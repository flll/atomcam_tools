## configs/atomcam_defconfig
```kconfig
BR2_mipsel=y
BR2_mips_xburst=y
# BR2_MIPS_SOFT_FLOAT is not set
BR2_MIPS_FP32_MODE_32=y
BR2_TOOLCHAIN_EXTERNAL=y
BR2_TOOLCHAIN_EXTERNAL_DOWNLOAD=y
BR2_TOOLCHAIN_EXTERNAL_URL="https://toolchains.bootlin.com/downloads/releases/toolchains/mips32el/tarballs/mips32el--glibc--stable-2017.05-toolchains-1-1.tar.bz2"
BR2_TOOLCHAIN_EXTERNAL_CUSTOM_PREFIX="mipsel-linux"
BR2_TOOLCHAIN_EXTERNAL_GCC_5=y
BR2_TOOLCHAIN_EXTERNAL_HEADERS_3_10=y
BR2_TOOLCHAIN_EXTERNAL_CUSTOM_GLIBC=y
BR2_TOOLCHAIN_EXTERNAL_CXX=y
BR2_WGET="wget --passive-ftp -nd -t 3"
BR2_SVN="svn --non-interactive"
BR2_SCP="scp"
BR2_BACKUP_SITE="http://sources.buildroot.net"
BR2_GNU_MIRROR="http://ftpmirror.gnu.org"
BR2_CPAN_MIRROR="http://cpan.metacpan.org"
BR2_STRIP_EXCLUDE_FILES="go2rtc"
BR2_OPTIMIZE_3=y
BR2_SHARED_STATIC_LIBS=y
BR2_PACKAGE_OVERRIDE_FILE=""
BR2_TARGET_GENERIC_HOSTNAME="atomtools"
BR2_TARGET_GENERIC_ISSUE=""
BR2_ROOTFS_DEVICE_CREATION_DYNAMIC_MDEV=y
BR2_TARGET_GENERIC_ROOT_PASSWD="atomcam2"
BR2_TARGET_GENERIC_GETTY_BAUDRATE_115200=y
# BR2_TARGET_GENERIC_REMOUNT_ROOTFS_RW is not set
BR2_ROOTFS_OVERLAY="/src/overlay_rootfs"
BR2_ROOTFS_POST_BUILD_SCRIPT="/src/buildscripts/post_fakeroot.sh"
BR2_ROOTFS_POST_IMAGE_SCRIPT="/src/buildscripts/post_image.sh"
BR2_LINUX_KERNEL=y
BR2_LINUX_KERNEL_CUSTOM_TARBALL=y
BR2_LINUX_KERNEL_CUSTOM_TARBALL_LOCATION="https://s3-us-west-2.amazonaws.com/download.wyzecam.com/firmware/gpl/Linux_kernel_3.10_Wyze_Cam_v3.tar.gz"
BR2_LINUX_KERNEL_PATCH="/src/patches/kernel"
BR2_LINUX_KERNEL_USE_CUSTOM_CONFIG=y
BR2_LINUX_KERNEL_CUSTOM_CONFIG_FILE="/src/configs/kernel.config"
BR2_LINUX_KERNEL_IMAGE_TARGET_CUSTOM=y
BR2_LINUX_KERNEL_LZMA=y
BR2_LINUX_KERNEL_IMAGE_TARGET_NAME="uImage"
BR2_LINUX_KERNEL_IMAGE_NAME="uImage.lzma"
BR2_PACKAGE_BUSYBOX_CONFIG="/src/configs/busybox.config"
BR2_PACKAGE_BUSYBOX_SHOW_OTHERS=y
BR2_PACKAGE_ALSA_UTILS=y
BR2_PACKAGE_ALSA_UTILS_ALSACONF=y
BR2_PACKAGE_ALSA_UTILS_ACONNECT=y
BR2_PACKAGE_ALSA_UTILS_APLAY=y
BR2_PACKAGE_ALSA_UTILS_ASEQDUMP=y
BR2_PACKAGE_FFMPEG=y
BR2_PACKAGE_FFMPEG_GPL=y
BR2_PACKAGE_FFMPEG_NONFREE=y
BR2_PACKAGE_FFMPEG_FFPROBE=y
BR2_PACKAGE_FFMPEG_POSTPROC=y
BR2_PACKAGE_FFMPEG_SWSCALE=y
BR2_PACKAGE_FFMPEG_EXTRACONF="--enable-indev=alsa --enable-outdev=alsa --enable-libmp3lame"
BR2_PACKAGE_LAME=y
BR2_PACKAGE_V4L2LOOPBACK_LEGACY=y
BR2_PACKAGE_V4L2LOOPBACK_LEGACY_UTILS=y
BR2_PACKAGE_XZ=y
BR2_PACKAGE_LSOF=y
BR2_PACKAGE_CIFS_UTILS=y
BR2_PACKAGE_E2FSPROGS=y
BR2_PACKAGE_DBUS=y
BR2_PACKAGE_MICROPYTHON=y
BR2_PACKAGE_MICROPYTHON_LIB=y
BR2_PACKAGE_PYTHON3=y
# BR2_PACKAGE_ALSA_LIB_HWDEP is not set
# BR2_PACKAGE_ALSA_LIB_OLD_SYMBOLS is not set
BR2_PACKAGE_FDK_AAC=y
BR2_PACKAGE_FREETYPE=y
BR2_PACKAGE_JPEG=y
BR2_PACKAGE_X264=y
BR2_PACKAGE_LIBCURL=y
BR2_PACKAGE_LIBCURL_CURL=y
BR2_PACKAGE_LIBEVENT=y
BR2_PACKAGE_POPT=y
BR2_PACKAGE_AVAHI=y
BR2_PACKAGE_AVAHI_DAEMON=y
BR2_PACKAGE_LIGHTTPD=y
BR2_PACKAGE_LIGHTTPD_PCRE=y
BR2_PACKAGE_LIGHTTPD_ZLIB=y
BR2_PACKAGE_OPENSSH=y
BR2_PACKAGE_WPA_SUPPLICANT=y
BR2_PACKAGE_WPA_SUPPLICANT_CLI=y
BR2_PACKAGE_BASH=y
BR2_PACKAGE_FILE=y
BR2_PACKAGE_SUDO=y
BR2_PACKAGE_HTOP=y
BR2_TARGET_ROOTFS_SQUASHFS=y
# BR2_TARGET_ROOTFS_TAR is not set
BR2_PACKAGE_HOST_E2FSPROGS=y
BR2_PACKAGE_HOST_GENEXT2FS=y
BR2_PACKAGE_HOST_MTD=y
BR2_PACKAGE_HOST_SQUASHFS=y
BR2_PACKAGE_HOST_UBOOT_TOOLS=y
BR2_PACKAGE_ATBM_WIFI=y
BR2_PACKAGE_BUSYBOX_INIT_SHOW_OTHERS=y
BR2_PACKAGE_DOSFSTOOLS_INIT=y
BR2_PACKAGE_GO2RTC=y
BR2_PACKAGE_H264BITSTREAM=y
BR2_PACKAGE_INGENIC_VIDEOCAP=y
BR2_PACKAGE_LIBTINYALSA=y
BR2_PACKAGE_LOGCONV=y
BR2_PACKAGE_V4L2RTSPSERVER=y
```

## custompackages/Config.in
```kconfig
menu "ATOMCam / WyzeCamV3 extensions"

# Packages that have no equivalent in stock Buildroot 2026.02.
source "$BR2_EXTERNAL_ATOMCAM_TOOLS_PATH/package/atbm_wifi/Config.in"
source "$BR2_EXTERNAL_ATOMCAM_TOOLS_PATH/package/busybox-init/Config.in"
source "$BR2_EXTERNAL_ATOMCAM_TOOLS_PATH/package/collections_c/Config.in"
source "$BR2_EXTERNAL_ATOMCAM_TOOLS_PATH/package/dosfstools-init/Config.in"
source "$BR2_EXTERNAL_ATOMCAM_TOOLS_PATH/package/exfatprogs-init/Config.in"
source "$BR2_EXTERNAL_ATOMCAM_TOOLS_PATH/package/go2rtc/Config.in"
source "$BR2_EXTERNAL_ATOMCAM_TOOLS_PATH/package/h264bitstream/Config.in"
source "$BR2_EXTERNAL_ATOMCAM_TOOLS_PATH/package/ingenic_samples/Config.in"
source "$BR2_EXTERNAL_ATOMCAM_TOOLS_PATH/package/ingenic_videocap/Config.in"
source "$BR2_EXTERNAL_ATOMCAM_TOOLS_PATH/package/libtinyalsa/Config.in"
source "$BR2_EXTERNAL_ATOMCAM_TOOLS_PATH/package/logconv/Config.in"
source "$BR2_EXTERNAL_ATOMCAM_TOOLS_PATH/package/micropython-lib/Config.in"
source "$BR2_EXTERNAL_ATOMCAM_TOOLS_PATH/package/oss/Config.in"
source "$BR2_EXTERNAL_ATOMCAM_TOOLS_PATH/package/v4l2cpp/Config.in"
source "$BR2_EXTERNAL_ATOMCAM_TOOLS_PATH/package/v4l2loopback-legacy/Config.in"
source "$BR2_EXTERNAL_ATOMCAM_TOOLS_PATH/package/v4l2rtspserver/Config.in"

# Removed during the Ubuntu 26.04 / Buildroot 2026.02 migration because the
# stock Buildroot tree now ships these packages and Buildroot rejects two
# definitions for the same name. If their old patches are still needed, port
# them to BR2_GLOBAL_PATCH_DIR (defconfig already supports it):
#   fdk-aac, ffmpeg, libcurl, libv4l, lighttpd, live555, log4cpp,
#   micropython, mjpg-streamer, ncurses, opus
# See git log for the historical contents of those package dirs.
#
# v4l2loopback was special: stock Buildroot ships v4l2loopback 0.15.3 which
# refuses to compile on kernels older than 4.0.0, but the Wyze Cam V3 GPL
# kernel is fixed at 3.10. We therefore re-instate the package under a new
# name `v4l2loopback-legacy` (sourced above) pinning the last upstream commit
# that still compiles on 3.10 plus our load-reduction patch.

endmenu
```

## custompackages/package/tailscale-prebuilt/Config.in
```kconfig
config BR2_PACKAGE_TAILSCALE_PREBUILT
	bool "tailscale (prebuilt mipsle binary)"
	depends on BR2_USE_MMU
	help
	  Install official Tailscale mipsle release binaries instead of
	  compiling from source. Required for AtomCam MIPS32r1 targets.

	  https://tailscale.com/

if BR2_PACKAGE_TAILSCALE_PREBUILT

config BR2_PACKAGE_TAILSCALE_PREBUILT_ENABLE
	bool "Enable Tailscale by default"
	default y
	help
	  Enable Tailscale daemon by default on system startup.
	  Can be controlled via WebUI (hack.ini).

endif
```

## custompackages/package/v4l2loopback-legacy/Config.in
```kconfig
config BR2_PACKAGE_V4L2LOOPBACK_LEGACY
	bool "v4l2loopback (legacy, kernel 3.10 compatible)"
	depends on BR2_LINUX_KERNEL
	help
	  Pinned-old fork of v4l2loopback (umlaeute/v4l2loopback git
	  commit a6d82287) that still compiles against the Linux 3.10
	  kernel shipped with the Wyze Cam V3 / ATOMCam GPL drop.

	  Buildroot 2026.02 ships v4l2loopback 0.15.3, which has
	  `#error This module is not supported on kernels before 4.0.0.`
	  hard-coded; we therefore keep this in-tree fork and apply the
	  custom OOM/load-reduction patch
	  (0001-v4l2loopback-oom.patch) from the original ATOMCam tree.

	  https://github.com/umlaeute/v4l2loopback

if BR2_PACKAGE_V4L2LOOPBACK_LEGACY

config BR2_PACKAGE_V4L2LOOPBACK_LEGACY_UTILS
	bool "utils"
	depends on BR2_USE_MMU # bash
	select BR2_PACKAGE_BUSYBOX_SHOW_OTHERS # bash
	select BR2_PACKAGE_BASH # runtime dependency
	select BR2_PACKAGE_SUDO # runtime dependency
	help
	  Install applications to interact with v4l2-loopback devices
	  ("virtual video devices").  Currently there is only a single
	  command line utility: v4l2loopback-ctl: tool to set
	  framerate, format and timeout image.

endif

comment "v4l2loopback-legacy needs a Linux kernel to be built"
	depends on !BR2_LINUX_KERNEL
```
