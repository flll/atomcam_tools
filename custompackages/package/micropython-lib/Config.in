## custompackages/package/micropython-lib/Config.in
```kconfig
config BR2_PACKAGE_MICROPYTHON_LIB
	bool "micropython-lib"
	depends on BR2_PACKAGE_MICROPYTHON
	select BR2_PACKAGE_PCRE2 # runtime
	help
	  Core Python libraries ported to MicroPython.

	  http://micropython.org
```
